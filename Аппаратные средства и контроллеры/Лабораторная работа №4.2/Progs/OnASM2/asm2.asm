;--- Шапка программы ---
list p=16f628a
__config b'11111100110001'
	TRISB   equ  06h ;(1-й банк)
    PORTB   equ  06h ;(0-й банк)
	SCRATCH equ  0Ch
	DIGIT   equ  0Dh
;--- Тело программы ---
org 0h
; можно выполнить 3 команды
; основной программы
goto  start
	org 4h
; подпрограмма обработки
; прерываний
; Работа программы:
;ничего не горит
;Загорается четверта-пауза
;Четвертая гаснет, загорается третья-пауза
;Загорается вторая-пауза
;Третья и вторая гаснут-пауза
start ; продолж. основной программы
      ; инициализация
      ; решение задачи
	nachalo:	; это просто метка, чтобы было понятно, куда возвращаться командой goto. Компилятор вычислит адрес команды, на которую она указывает (адрес первой команды после метки) и подставит этот адрес в команду goto
		bsf PORTB,3	
			Call pause	 ;pause - это метка, которая стоит перед подпрограммой (она указывает на первую команду подпрограммы)
		bcf PORTB,3
		bsf PORTB,2	
			Call pause
		bsf PORTB,1
			Call pause
		bcf PORTB, 2
		bcf PORTB, 1
			Call pause
	goto nachalo
	
	pause; примерно 1 секунда=1 Герц
        MOVLW    0FFh         ;Загрузить 0FFh в регистр W
        MOVWF    SCRATCH      ;Загрузить регистр W в SCRATCH
        MOVLW    0FFh         ;Загрузить 0FFh в регистр W
        MOVWF    DIGIT        ;Загрузить регистр W в DIGIT
		LOOP
        DECFSZ   SCRATCH,1    ;Уменьшить SCRATCH на 1
        GOTO     LOOP         ;и переходить обратно, пока не станет =0
        DECFSZ   DIGIT,1      ;Уменьшить DIGIT на 1
        GOTO     LOOP         ;и переходить на метку LOOP, пока не станет =0
    RETURN                ;Вернуться из подпрограммы
end